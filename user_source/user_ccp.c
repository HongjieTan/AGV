/*#####################################################################################################
  @file    
  @author  CS Team
  @brief   

  #####################################################################################################
  */

/* Includes ------------------------------------------------------------------*/
#include "stm32f3xx.h"
#include "user_ccp.h"
#include "user_can.h"
/* Private typedef -----------------------------------------------------------*/
/* Private define ------------------------------------------------------------*/
/* Private macro -------------------------------------------------------------*/

/* Private variables ---------------------------------------------------------*/

/* Private function prototypes -----------------------------------------------*/
/* Exported functions --------------------------------------------------------*/

/*##################################################################################################*/ 
/*****************************************************************************************************
  * @brief
  * @note
  * @param
  * @param
  * @retval
	***************************************************************************************************
  */
	
uint32_t myTest = 0x11223344;
	
ccpReadT ccpReadG[4] = {0};
uint8_t  ccpwriteFlgG = 0;
uint32_t ccpWriteAddressG = 0;


void ccpCmdF(uint8_t *inDataBuf)
{
	
	if(inDataBuf[0] == 0x5a)//  write command
	{
		if(inDataBuf[1] == 0x55)// write address 
		{	
			ccpWriteAddressG = ((uint32_t*)inDataBuf)[1];
			((uint16_t*)inDataBuf)[0] = 0;
			ccpwriteFlgG = 0x35;
		} 
		else if((inDataBuf[1] == 0xaa)&&(ccpwriteFlgG == 0x35))// write data
		{
			ccpwriteFlgG = 0x00;
			((uint16_t*)inDataBuf)[0] = 0;
			switch(inDataBuf[2])
			{
				case 1://  8bit
					((uint8_t*)ccpWriteAddressG)[0] = ((uint8_t*)inDataBuf)[4];
					break;	
				
				case 2://  16 bit
					((uint16_t*)ccpWriteAddressG)[0] = ((uint16_t*)inDataBuf)[2];
					break;		
				
				case 4://  32 bit
					((uint32_t*)ccpWriteAddressG)[0] = ((uint32_t*)inDataBuf)[1];
					break;	
				
				default:
					break;
			}
		}
	}
	else if(inDataBuf[0] == 0x3a)// read command
	{
			inDataBuf[0] = 0x00;

			ccpReadG[inDataBuf[3]].ccpAddress = ((uint32_t*)inDataBuf)[1];
			ccpReadG[inDataBuf[3]].dataType = inDataBuf[2];
	}
	else
	{
	}
}
/*****************************************************************************************************
  * @brief
  * @note
  * @param
  * @param
  * @retval
	***************************************************************************************************
  */

/*****************************************************************************************************
  * @brief
  * @note
  * @param
  * @param
  * @retval
	***************************************************************************************************
  */

/*****************************************************************************************************
  * @brief
  * @note
  * @param
  * @param
  * @retval
	***************************************************************************************************
  */

/*****************************************************************************************************
  * @brief
  * @note
  * @param
  * @param
  * @retval
	****************************************************************************************************
  */

	/*****************************************************************************************************
  * @brief
  * @note
  * @param
  * @param
  * @retval
	******************************************************************************************************
  */
	
/*####################################################################################################*/  
/************************** (C) COPYRIGHT CRESON *****END OF FILE**************************************/











